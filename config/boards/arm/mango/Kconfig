## config/boards/arm/mango/Kconfig
```kconfig
config BOARD_ENABLE_DCDC
	bool "Enable DCDC mode"
	select SOC_DCDC_NRF52X
	default y
	depends on (BOARD_MANGO_LEFT || BOARD_MANGO_RIGHT)

config MANGO_IDLE_VCC_OFF
	bool "Cut VCC (LEDs and display) when idle, redraw the display on wake"
	depends on ZMK_RGB_UNDERGLOW && !ZMK_RGB_UNDERGLOW_AUTO_OFF_IDLE
```

## config/boards/arm/mango/Kconfig.defconfig
```kconfig
if BOARD_MANGO_LEFT

	config ZMK_KEYBOARD_NAME
	default "Mango"

	config ZMK_SPLIT_BLE_ROLE_CENTRAL
    default y

	config ZMK_USB
	default y

endif # BOARD_MANGO_LEFT

if BOARD_MANGO_RIGHT

	config ZMK_KEYBOARD_NAME
	default "Mango right"

endif # BOARD_MANGO_RIGHT

if BOARD_MANGO_LEFT || BOARD_MANGO_RIGHT

	config BOARD
		default "mango"

	config ZMK_SPLIT
		default y

	config ZMK_DISPLAY
		select LV_USE_CONT
		select LV_FONT_MONTSERRAT_26
		select LV_FONT_MONTSERRAT_20
		select LV_FONT_MONTSERRAT_16
		select LV_USE_LABEL
		select LV_USE_IMG

	if ZMK_DISPLAY

		config SYSTEM_WORKQUEUE_STACK_SIZE
			default 2048

		# Zephyr's 2048 default is too small for the custom status screen: LVGL
		# allocations fail and the board hangs at boot. (ZMK only raises it for its
		# built-in screen.)
		config LV_Z_MEM_POOL_SIZE
			default 8192 if ZMK_DISPLAY_STATUS_SCREEN_CUSTOM

		choice LV_FONT_DEFAULT
			default LV_FONT_DEFAULT_MONTSERRAT_26
		endchoice

		choice ZMK_LV_FONT_DEFAULT_SMALL
			default ZMK_LV_FONT_DEFAULT_SMALL_MONTSERRAT_26
		endchoice

		config LV_HOR_RES_MAX
			int "Max horizontal resolution"
			default 160

		config LV_VER_RES_MAX
			int "Max vertical resolution"
			default 68

		config SPI
			default y

		config LS0XX
			default y

		config LV_Z_BITS_PER_PIXEL
			default 1

		choice LV_COLOR_DEPTH
			default LV_COLOR_DEPTH_1
		endchoice

		config LV_DPI_DEF
			default 30

		config LV_Z_VDB_SIZE
			default 16

		choice ZMK_DISPLAY_STATUS_SCREEN
			default ZMK_DISPLAY_STATUS_SCREEN_CUSTOM
		endchoice

	endif # ZMK_DISPLAY

	if USB_DEVICE_STACK

		config USB_NRFX
			default y

	endif # USB_DEVICE_STACK

	config BT_CTLR
	default BT

	config ZMK_BLE
		default y

	menuconfig CUSTOM_WIDGET_BATTERY_STATUS
		bool "custom battery status widget"

	menuconfig CUSTOM_WIDGET_OUTPUT_STATUS
		bool "custom output status widget"
		depends on !ZMK_SPLIT || ZMK_SPLIT_ROLE_CENTRAL

	menuconfig CUSTOM_WIDGET_PERIPHERAL_STATUS
		bool "custom peripheral status widget"
		depends on ZMK_SPLIT && !ZMK_SPLIT_ROLE_CENTRAL

	menuconfig CUSTOM_WIDGET_PROFILE_STATUS
		bool "custom profile status widget"
		depends on !ZMK_SPLIT || ZMK_SPLIT_ROLE_CENTRAL

	menuconfig CUSTOM_WIDGET_LAYER_STATUS
		bool "custom layer status widget"
		depends on !ZMK_SPLIT || ZMK_SPLIT_ROLE_CENTRAL

	menuconfig CUSTOM_WIDGET_PET_STATUS
		bool "custom pet status widget"
		depends on !ZMK_SPLIT || ZMK_SPLIT_ROLE_CENTRAL
		select LV_USE_IMG
		select LV_USE_ANIMATION
		select ZMK_WPM

	if CUSTOM_WIDGET_PET_STATUS

		config CUSTOM_WIDGET_PET_WALK_WPM
			int "Lower WPM limit for pet to start walking"
			default 10

		config CUSTOM_WIDGET_PET_RUN_WPM
			int "Lower WPM limit for pet to start running"
			default 50
		
	endif # CUSTOM_WIDGET_PET_STATUS

endif # BOARD_MANGO_LEFT || BOARD_MANGO_RIGHT
```
